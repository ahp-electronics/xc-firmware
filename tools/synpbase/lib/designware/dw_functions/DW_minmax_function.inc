@Ef//]8CNCRs:/$/#MHbDO$H0/blND.N0jJ4U./b48HC#oNMIs8C/Ik_VMHO0F/M#7lW_HNMlGk_VMHO0FHM3M4OyR/f
/------------------------------------------------------------------------------------------------/-
//
/R0aHDRCRRRRRRe:RCDsHFVoRk0MOH#FM
R//qEk0FRsRRRRR:NR]sEH#RivR
R//BbFlNRM$RRRR:$R1MHbDO$H0ROQM3/
/R07NCRRRRRRRRq:Rk.oR6.,Rj
jU/e/RCHs#FRMRR:RRR4d3

///-/----------------------------------------------------------------------------------------------
--Sw//HRM80REClRHM-CRsJskHCh#RR4-RRlOFbNNs0#FsSSS
VOkM0MHFRFrIsC8DMEo0R4-RRj:R9WR7wH_lMO_0;H
SM0bkRFrIsC8DMEo0*lMk_bHMkR0#-RR4:9RjS
N;Ss
SCroRI8FsDoCM0-ERR:4RRRj9RlRRHRM;Rs
SCroSI8FsDoCM0-ERR:4RRSj90;lb
H
SMo0CCHsS,;R[
SS
LHCoMSS
SMlHSN=RrsIF8MDCoR0E-RR4:9Rj;S
S
VSSFRs5HRR=4H;RRM<RkHl_M0bk#H;RRH=RR4+RRS2
SoLCHSM
S/S/tRC0CENORbHMkV0RsRFlNNss$RRR
SSS/$/#MC0E#RH#DbFF_lDHH60RjSj
SFSVs[5RRj=R;RR[<FRIsC8DMEo0;RR[=RR[+RR42S
SSlS0b[rRR=9RRRNr[RR+HRR*I8FsDoCM09ER;S
SS/S/tRC00REClRHMPkNDCMRN8MRH8SCGSSS
SHSSVRR55b0lrsIF8MDCo-0E4&9RRMlHrsIF8MDCo-0E4R92|5|S~b0lrsIF8MDCo-0E4&9RRH~lMFrIsC8DMEo0-R492
R2SSSSSoLCHSM
SSSSS5HV0Rlb<HRlM
2RSSSSSlSSH=MRRb0l;S
SSCSSM
8SSSSSCCD#R5HVRb0lrsIF8MDCo-0E4&9RRH~lMFrIsC8DMEo0-R492S
SSlSSH=MRRb0l;S
SCSM8
7SSWlw_H0M_ORR=l;HM
MSC8SS
CVM8k0MOHSFMS
SSSSSS
kSVMHO0FrMRI8FsDoCM0-ERR:4RRRj97_Wwl_HMk;M#
MSHbRk0rsIF8MDCo*0EM_klHkMb0-#RR:4RRSj9NS;

CSsoIRrFDs8C0MoERR-4RR:jR9RRHRlMR;R
CSsoISrFDs8C0MoERR-4RR:j09Sl
b;
MSH0CCos,R	R
D;SoLCH
MSSHSlMRS=NFrIsC8DMEo0R4-RRj:R9S;
SS
SV5FsR=	RRR4;	RR<M_klHkMb0R#;	RR=	RR+4
R2SCSLo
HMS/SS/0tCROCNEMRHbRk0VlsFRsNsNR$RRS
SS#//$EM0C##HRFDFbH_DlRH06
jjSVSSFRs5DRR=jD;RRI<RFDs8C0MoED;RRD=RR4+RRS2
S0SSlRbrDRR9=rRNR+DRR*	RRsIF8MDCoR0E9S;
SSS
SVSH5b0lRl<RH
M2SSSSlRHM=lR0bS;
S8CMSR
SR7RRWlw_HkM_M=#RRMlH;SS
CSM8
MSC8MVkOF0HMS

/H/wM08RElCRN-GRRJsCkCHs#RRh-RR4ObFlN0sNFSs#SV
Sk0MOHRFMrsIF8MDCoR0E-RR4:9RjRw7W_GlN_;0O
MSHbRk0rsIF8MDCo*0EM_klHkMb0-#RR:4RRSj9NS;

CSsoIRrFDs8C0MoERR-4RR:jR9RRNRlGR;R
CSsoISrFDs8C0MoERR-4RR:j09Sl
b;
MSH0CCos,SlR
M;SL
SCMoHSS
SlSNG=rRNI8FsDoCM0-ERR:4RR;j9RS
SV5FsR=lRRR4;lRR<M_klHkMb0R#;lRR=lRR+4
R2SCSLo
HMS/SS/0tCROCNEMRHbRk0VlsFRsNsNR$RRS
SS#//$EM0C##HRFDFbH_DlRH06
jjSVSSFRs5MRR=jM;RRI<RFDs8C0MoEM;RRM=RR4+RRS2
S0SSlRbrMRR9=rRNR+MRR*lRRsIF8MDCoR0E9
;SSSSS
SSSSRHV50R5lIbrFDs8C0MoE9-4Rl&RNIGrFDs8C0MoE9-42|R|S05~lIbrFDs8C0MoE9-4R~&RlrNGI8FsDoCM04E-92R2
SSSSCSLo
HMSSSSSVSH5b0lRR>=l2NG
SSSSSSSlRNG=lR0bS;RSSSSSS
SSCSSMR8RS
SSSSSSCCD#R5HVRl~0bFrIsC8DMEo0-R49&NRlGFrIsC8DMEo0-R492S
SSlSSN=GRRb0l;S
SCSM8SS
S7_Wwl_NG0=ORRGlN;C
SM
8SS8CMVOkM0MHF
SSS
SSS
kSVMHO0FrMRI8FsDoCM0-ERR:4RRRj97_Wwl_NGk;M#
MSHbRk0rsIF8MDCo*0EM_klHkMb0-#RR:4RRSj9NS;

CSsoIRrFDs8C0MoERR-4RR:jR9RRNRlGR;R
CSsoISrFDs8C0MoERR-4RR:j09Sl
b;
MSH0CCos,SFR
b;SL
SCMoHSS
SlSNG=rRNI8FsDoCM0-ERR:4RR;j9RS
SV5FsR=FRRR4;FRR<M_klHkMb0R#;FRR=FRR+4
R2SCSLo
HMS/SS/0tCROCNEMRHbRk0VlsFRsNsNR$RRS
SS#//$EM0C##HRFDFbH_DlRH06
jjSVSSFRs5bRR=jb;RRI<RFDs8C0MoEb;RRb=RR4+RRS2
S0SSlRbrbRR9=rRNR+bRR*FRRsIF8MDCoR0E9S;
S
SSSHSSV05Rl>bR=NRlGRR2RS
SSNSlGRR=0;lb
CSSM
8RSRRRRw7W_GlN_#kMRl=RNSG;
MSC8SR
CVM8k0MOH
FM




